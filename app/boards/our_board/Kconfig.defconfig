## app/boards/our_board/Kconfig.defconfig
```kconfig
config HEAP_MEM_POOL_ADD_SIZE_BOARD
	int
	default 4096 if BOARD_OUR_BOARD_ESP32S3_PROCPU
```

## app/boards/our_board/Kconfig.our_board
```kconfig
config BOARD_OUR_BOARD
	select SOC_ESP32S3_WROOM_N8
	select SOC_ESP32S3_PROCPU if BOARD_OUR_BOARD_ESP32S3_PROCPU
	select SOC_ESP32S3_APPCPU if BOARD_OUR_BOARD_ESP32S3_APPCPU
    
```

## app/boards/our_board/board.yml
```yaml
board:
  name: our_board
  full_name: our_board_esp32_s3 
  vendor: espressif
  socs:
  - name: esp32s3
```
